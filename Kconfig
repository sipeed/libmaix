## Kconfig
```kconfig
mainmenu "C/CPP CMake project framework Kconfig configuration"

menu "Toolchain configuration"
	config TOOLCHAIN_PATH
		string "toolchain path"
		default "/opt/toolchain-sunxi-musl/toolchain/bin"

	config TOOLCHAIN_PREFIX
		string "toolchain prefix"
		default "arm-openwrt-linux-muslgnueabi-"
endmenu

menu "Target chip configuration"
	choice ARCH
		prompt "Chip architecture"
		help
			"select compile platform architecture"
		config ARCH_V831
			bool "compile for arch V831"
		config ARCH_V833
			bool "compile for arch V833"
		config ARCH_R329
			bool "compile for arch R329"
		config ARCH_Desktop
			bool "compile for arch Linux Desktop"
	endchoice
	menu "upload dist configuration, only need if you use python3 project.py upload command"
		config TARGET_IP
			string "target's ip address"
			default "192.168.0.123"
			help
				"only need if you use python3 project.py upload command"
		config TARGET_USER
			string "target's username"
			default "root"
			help
				"only need if you use python3 project.py upload command"
		config TARGET_DIST_DIR
			string "which directory the dist files copy to"
			default "/root/maix_dist"
			help
				"only need if you use python3 project.py upload command"
		config TARGET_USER_PASSWD
			string "target's user password"
			default ""
			help
				"only need if you use python3 project.py upload command"
	endmenu
endmenu


menu "Components configuration"
	osource "${SDK_PATH}/components/*/Kconfig"
	osource "${PROJECT_PATH}/*/Kconfig"
endmenu
```

## components/libimage/Kconfig
```kconfig
config COMPONENT_IMAGE_ENABLE
    bool "Enable libimage component"
    default y
    help
        Select this option to enable use libimage base on opencv4.
```

## components/libmaix/Kconfig
```kconfig
menu "libmaix configuration"
    config LIBMAIX_ENABLED
        bool "Enable libmaix, a embeded AI lib"
        default y
        help
            Select this option to enable libmaix and show the submenu.
endmenu
```

## components/maix/Kconfig
```kconfig
config COMPONENT_MAIX_ENABLE
    bool "Enable maix component"
    default n
    help
        Select this option to enable use maix base on source.
```

## components/maix_copy/Kconfig
```kconfig
config COMPONENT_MAIX_XXXX_ENABLE
    bool "Enable maix_xxxx component"
    default n
    help
        Select this option to enable use maix_xxxx base on opencv4.
```

## components/maix_cv_image/Kconfig
```kconfig
config COMPONENT_IMAGE_ENABLE
    bool "Enable maix_cv_image component"
    default y
    help
        Select this option to enable use maix_cv_image base on opencv4.
```

## components/maix_dls831/Kconfig
```kconfig
config COMPONENT_MAIX_DLS831_ENABLE
    bool "Enable maix_dls831 component"
    default n
    help
        Select this option to enable use maix_dls831 base on opencv4 with lvgl.
```

## components/maix_gs831/Kconfig
```kconfig
config COMPONENT_MAIX_GS831_ENABLE
    bool "Enable maix_gs831 component"
    default n
    help
        Select this option to enable use maix_gs831 base on opencv4.
```

## components/maix_speech/Kconfig
```kconfig
config COMPONENT_LIBMS_ENABLE
    bool "Enable libms component"
    default n
    help
        Select this option to enable use libms base on Maix-Speech.
menu "component libms configuration"
	depends on COMPONENT_LIBMS_ENABLE
	config ASR_ENABLE
		bool "enable asr"
		default y
	config MFCC_ENABLE
		bool "enable mfcc-with-vad"
		default y
endmenu
```

## components/third_party/Kconfig
```kconfig
config COMPONENT_3RD_PARTY_ENABLE
	bool "Enable 3rd party component, include lvgl,cjson,libjpeg"
	default y

menu "3rd party configuration"
	depends on COMPONENT_3RD_PARTY_ENABLE
	config LVGL_ENABLE
		bool "enable LittleVGL"
		default y
	config CJSON_ENABLE
		bool "enable cJSON"
		default y
	config IMLIB_ENABLE
		bool "enable imlib"
		default y
	config APRILTAG_ENABLE
		bool "enable apriltag"
		default y
	config LIBJPEG_ENABLE
		bool "enable libjpeg"
		default y
	config SQLITE3_ENABLE
		bool "enable sqlite3"
		default y
	config ZBAR_ENABLE
		bool "enable zbar"
		default y
endmenu
```
